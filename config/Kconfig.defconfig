## config/Kconfig.defconfig
```kconfig
if SHIELD_BT65_V1

config ZMK_KEYBOARD_NAME
    default "BT65 v1"

if ZMK_DISPLAY

config I2C
    default y

config SSD1306
    default y

endif # ZMK_DISPLAY

endif # SHIELD_BT65_V1
```
